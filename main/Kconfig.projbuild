## main/Kconfig.projbuild
```kconfig
menu "DCC-Controller Configuration"

    config ROTARY_ENCODER_ENABLE
        bool "Enable rotary encoder"
        default n
        help
            Enable support for a quadrature rotary encoder using the espressif/knob component.

    config ROTARY_ENCODER_GPIO_A
        int "Rotary encoder GPIO A"
        range 0 48
        default 4
        depends on ROTARY_ENCODER_ENABLE
        help
            GPIO number connected to encoder channel A.

    config ROTARY_ENCODER_GPIO_B
        int "Rotary encoder GPIO B"
        range 0 48
        default 5
        depends on ROTARY_ENCODER_ENABLE
        help
            GPIO number connected to encoder channel B.

    config ROTARY_ENCODER_DEFAULT_DIRECTION
        int "Rotary encoder default direction"
        range 0 1
        default 0
        depends on ROTARY_ENCODER_ENABLE
        help
            0: clockwise increases count, 1: clockwise decreases count.

    config ROTARY_ENCODER_SW_ENABLE
        bool "Enable rotary encoder SW button"
        default y
        depends on ROTARY_ENCODER_ENABLE
        help
            Enable support for the encoder center push button (SW).

    config ROTARY_ENCODER_GPIO_SW
        int "Rotary encoder GPIO SW"
        range 0 48
        default 6
        depends on ROTARY_ENCODER_SW_ENABLE
        help
            GPIO number connected to encoder push switch (SW).

    config ROTARY_ENCODER_SW_ACTIVE_LEVEL
        int "Rotary encoder SW active level"
        range 0 1
        default 0
        depends on ROTARY_ENCODER_SW_ENABLE
        help
            0: active low, 1: active high.

    config ROTARY_ENCODER_2_ENABLE
        bool "Enable second rotary encoder (roster throttle)"
        default n
        depends on ROTARY_ENCODER_ENABLE
        help
            Enable a second quadrature rotary encoder dedicated to roster throttle control.

    config ROTARY_ENCODER_2_GPIO_A
        int "Second rotary encoder GPIO A"
        range 0 48
        default 17
        depends on ROTARY_ENCODER_2_ENABLE
        help
            GPIO number connected to second encoder channel A.

    config ROTARY_ENCODER_2_GPIO_B
        int "Second rotary encoder GPIO B"
        range 0 48
        default 18
        depends on ROTARY_ENCODER_2_ENABLE
        help
            GPIO number connected to second encoder channel B.

    config ROTARY_ENCODER_2_DEFAULT_DIRECTION
        int "Second rotary encoder default direction"
        range 0 1
        default 0
        depends on ROTARY_ENCODER_2_ENABLE
        help
            0: clockwise increases count, 1: clockwise decreases count.

    config ROTARY_ENCODER_2_SW_ENABLE
        bool "Enable second rotary encoder SW button"
        default y
        depends on ROTARY_ENCODER_2_ENABLE
        help
            Enable support for the second encoder center push button (SW).

    config ROTARY_ENCODER_2_GPIO_SW
        int "Second rotary encoder GPIO SW"
        range 0 48
        default 21
        depends on ROTARY_ENCODER_2_SW_ENABLE
        help
            GPIO number connected to second encoder push switch (SW).

    config ROTARY_ENCODER_2_SW_ACTIVE_LEVEL
        int "Second rotary encoder SW active level"
        range 0 1
        default 0
        depends on ROTARY_ENCODER_2_SW_ENABLE
        help
            0: active low, 1: active high.

endmenu
```
